## neuro-sense-puck/firmware/sdkconfig.defaults
```kconfig
# sdkconfig.defaults — Neuro Sense Puck
# Optimized for low power BLE + periodic WiFi on ESP32-C6

CONFIG_IDF_TARGET="esp32c6"
CONFIG_ESP_SYSTEM_PANIC_PRINT_REBOOT=y

# Power management
CONFIG_PM_ENABLE=y
CONFIG_PM_DFS_INIT_AUTO=y
CONFIG_FREERTOS_HZ=1000

# BLE
CONFIG_BT_ENABLED=y
CONFIG_BTDM_CTRL_MODE_BLE_ONLY=y
CONFIG_BT_BLE_42_FEATURES_SUPPORTED=y
CONFIG_BT_BLE_50_FEATURES_SUPPORTED=y

# WiFi
CONFIG_ESP32_WIFI_ENABLE_WIFI_TX_STATS=y

# Deep sleep
CONFIG_ESP32_ENABLE_DEEP_SLEEP_WAKEUP_STUB=y

# Flash
CONFIG_PARTITION_TABLE_CUSTOM=y
CONFIG_PARTITION_TABLE_CUSTOM_FILENAME="partitions.csv"

# Log
CONFIG_LOG_DEFAULT_LEVEL_INFO=y
CONFIG_LOG_MAXIMUM_LEVEL_DEBUG=y
```
